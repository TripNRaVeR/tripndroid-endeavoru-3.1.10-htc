## drivers/tripndroid/Kconfig
```kconfig
menu "TripNDroid Framework"

config TRIPNDROID_FRAMEWORK
	bool "TripNDroid Framework"
	select ARM_L1_CACHE_SHIFT_6
	default n
	help
	  Implement a custom kernel overhaul for mobile Android devices.
	  Currently only supporting Tegra 3 cpu's. Will be platform
	  independent in the future

menuconfig TDF_CPU_MANAGEMENT
	bool "TDF CPU Management"
	depends on TRIPNDROID_FRAMEWORK
	default n
	help
	  Choose this option if you want TDF to control the cpus

	source "drivers/tripndroid/cpu_management/Kconfig"

menuconfig TDF_SCHED_MANAGEMENT
	bool "TDF Scheduler Management"
	depends on TRIPNDROID_FRAMEWORK
	default n
	help
	  Choose this option if you want TDF to control the linux scheduler

	source "drivers/tripndroid/sched_management/Kconfig"


endmenu
```

## drivers/tripndroid/cpu_management/Kconfig
```kconfig
config TDF_CPU_HOTPLUG
        bool "TripNDroid CPU hot-plugging"
	depends on TDF_CPU_MANAGEMENT && HOTPLUG_CPU && CPU_FREQ && !ARCH_CPU_PROBE_RELEASE
	default n
	help
	  This option enables turning CPUs on/off according to scheduler loads
```

## drivers/tripndroid/sched_management/Kconfig
```kconfig
config TDF_RQ_STATS
	bool "TDF Scheduler rq statistics"
	depends on TDF_SCHED_MANAGEMENT && !TEGRA_AUTO_HOTPLUG
	help
	  This option enables load statistics from the scheduler to be
	  available to drivers like for example cpu hotplug drivers.
	  It is platform independent and every generic hotplug driver is
	  able to use it.
	  usage: sched_get_nr_running_avg();
```
